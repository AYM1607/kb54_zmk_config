## boards/kb54/kb54_nrf52840/Kconfig.defconfig
```kconfig
if BOARD_KB54_NRF52840_L

config ZMK_SPLIT_BLE_ROLE_CENTRAL
    default y

endif # BOARD_KB54_NRF52840_L



if BOARD_KB54_NRF52840_L || BOARD_KB54_NRF52840_R

config ZMK_SPLIT
    default y

config BT_CTLR
    default BT

config ZMK_KSCAN_MATRIX_WAIT_BETWEEN_OUTPUTS
    default 5

# These come from boards/shields/nice_view figure out what they're for.
config LV_Z_VDB_SIZE
    default 100

config LV_DPI_DEF
    default 161

config LV_Z_BITS_PER_PIXEL
    default 1

choice LV_COLOR_DEPTH
    default LV_COLOR_DEPTH_1
endchoice

choice ZMK_DISPLAY_WORK_QUEUE
    default ZMK_DISPLAY_WORK_QUEUE_DEDICATED
endchoice

choice ZMK_DISPLAY_STATUS_SCREEN
    default ZMK_DISPLAY_STATUS_SCREEN_CUSTOM
endchoice

config LV_Z_MEM_POOL_SIZE
    default 4096 if ZMK_DISPLAY_STATUS_SCREEN_CUSTOM

config ZMK_DISPLAY_STATUS_SCREEN_CUSTOM
    imply KB54_WIDGET_STATUS

config KB54_WIDGET_STATUS
    bool "Custom KB54 status widget"
    select LV_USE_IMG
    select LV_USE_CANVAS
    select LV_FONT_MONTSERRAT_22
    select LV_FONT_MONTSERRAT_18
    select LV_FONT_MONTSERRAT_16
    select LV_FONT_MONTSERRAT_14
    select LV_FONT_MONTSERRAT_12
    select LV_FONT_UNSCII_8
    select LV_FONT_UNSCII_16

if USB

config USB_NRFX
    default y

config USB_DEVICE_STACK
    default y

endif # USB

endif # BOARD_KB54_NRF52840_L || BOARD_KB54_NRF52840_R
```

## boards/kb54/kb54_nrf52840/Kconfig.kb54_nrf52840_r
```kconfig
config BOARD_KB54_NRF52840_R
    select SOC_NRF52840_QIAA
    select ZMK_BOARD_COMPAT
```

## boards/kb54/kb54_nrf52840/board.yml
```yaml
boards:
  - name: kb54_nrf52840_l
    vendor: kb54
    socs:
      - name: nrf52840
        variants:
          - name: zmk
  - name: kb54_nrf52840_r
    vendor: kb54
    socs:
      - name: nrf52840
        variants:
          - name: zmk
```

## boards/kb54/kb54_nrf52840/kb54_nrf52840_r_nrf52840_zmk_defconfig
```kconfig
# Enable both USB and BLE
CONFIG_ZMK_USB=y
CONFIG_ZMK_BLE=y

# Keyboard IDs
CONFIG_ZMK_KEYBOARD_NAME="KB54 Right"

# BLE TX Power
CONFIG_BT_CTLR_TX_PWR_PLUS_8=y

# Enable MPU
CONFIG_ARM_MPU=y

# Enable GPIO
CONFIG_GPIO=y

# Flash configuration
CONFIG_SETTINGS=y
CONFIG_MPU_ALLOW_FLASH_WRITE=y
CONFIG_NVS=y
CONFIG_SETTINGS_NVS=y
CONFIG_FLASH=y
CONFIG_FLASH_PAGE_LAYOUT=y
CONFIG_FLASH_MAP=y

# Enable 32kHz crystal
CONFIG_CLOCK_CONTROL_NRF_K32SRC_XTAL=y

CONFIG_ZMK_USB_LOGGING=n
CONFIG_ZMK_RTT_LOGGING=n

# Battery
CONFIG_ZMK_BATTERY_REPORTING=y
CONFIG_ZMK_BATTERY_REPORT_INTERVAL=15
CONFIG_ZMK_BATTERY_REPORTING_FETCH_MODE_STATE_OF_CHARGE=y

# Display
CONFIG_ZMK_DISPLAY=y
CONFIG_ZMK_DISPLAY_BLANK_ON_IDLE=n

# Code output
CONFIG_USE_DT_CODE_PARTITION=y
CONFIG_BUILD_OUTPUT_UF2=y
```
